## Kconfig
```kconfig
# Linux skeleton Kconfig entry point.
# Business symbols keep the Dust naming convention: TRD_*.

mainmenu "Dust Linux Skeleton"

config PRJ_MAIN
    bool "Main application"
    default y

if PRJ_MAIN

source "framework/algorithm/Kconfig"
source "framework/cmd/Kconfig"
source "framework/shell/Kconfig"
source "framework/modules/Kconfig"
source "framework/topic/Kconfig"
source "project/Kconfig"

endif # PRJ_MAIN
```

## framework/algorithm/Kconfig
```kconfig
# algorithm/Kconfig —— 算法能力：滤波与数学工具。
# 架构层能力默认 n，由业务层 select 拉起。

config DUST_FLT_KALMAN
    bool "kalman filter"
    default n
    help
      Linear Kalman filter (algorithm/filter/kalman/kalman_filter.hpp).

config DUST_FLT_KALMAN_EKF
    bool "extended kalman filter"
    default n
    select DUST_FLT_KALMAN
    help
      Extended Kalman filter on top of the kalman filter (algorithm/filter/kalman/ekf.hpp).

config DUST_FLT_QUATERNION
    bool "quaternion attitude"
    default n
    help
      Quaternion attitude helpers (algorithm/filter/attitude/quaternion_attitude.hpp).

config DUST_MATH_ANGLE
    bool "angle helpers"
    default n
    help
      Angle wrap/compare helpers (algorithm/math/angle.hpp).
```

## framework/cmd/Kconfig
```kconfig
# cmd/Kconfig —— 横切辅助能力（当前只有运行配置读取）。
# 架构层能力默认 n，由业务层 select 拉起。
#
# 调试台与日志归 framework/shell/，不在本文件。

config DUST_CMD_CONFIG
    bool "YAML runtime config loader"
    default n
    help
      Per-thread YAML parameter loading and field validation (cmd/config).
```

## framework/drivers/Kconfig
```kconfig
# drivers/Kconfig —— 底层通讯/设备驱动层。
# 架构层能力默认 n，由业务层 select 拉起。
#
# 命名族（照父架构 framework/drivers/Kconfig，不许自创前缀）：
#   DUST_COM_*  通讯驱动（UART / USB / RS485 / CAN / ETHERCAT）
#   DUST_DEV_*  设备驱动（GPIO / PWM）
#
# 骨架阶段没有任何实现。新增驱动时在这里加 config，
# 并在 CMakeLists.txt 里按同一个符号建 target。

config DUST_COM_ETHERCAT
    bool "EtherCAT master (SOEM)"
    default n
    help
      用户态 EtherCAT 主站：打开网口、枚举从站、周期交换过程数据。
      依赖系统已安装 SOEM（/usr/local/lib/libsoem.so）。
```

## framework/shell/Kconfig
```kconfig
# shell/Kconfig —— 调试台底座与子命令族（boot / log / var / thread）。
# 架构层能力默认 n，由业务层 select 拉起。

config DUST_CMD_SHELL
    bool "Self-maintained debug console (thread + command dispatch)"
    default n
    help
        Console thread: line input, command dispatch and log transport.
        var/log sub-commands are gated by their own symbols.

config DUST_CMD_SHELL_LOG
    bool "log system + log sub-commands (log list/on/off)"
    default n
    select DUST_CMD_SHELL
    help
        Self-made log system: INF/ERR/OK/WRN with colour, DBG selectable
        streaming via log on/off. Requires the shell thread.

config DUST_CMD_SHELL_VAR
    bool "var sub-commands (var list/get/set)"
    default n
    select DUST_CMD_SHELL
    help
        Debug variable interaction: var list / get <name> / set <name> <v>.
        Threads register variables via REGISTER_SHELL_VAR().
```

## project/Kconfig
```kconfig
# 业务门禁 Kconfig（位置：<repo>/project）
# 业务门禁符号（TRD_ / USE_）保持原名，不加 DUST_ 前缀
# 业务门禁 select 的架构符号统一 DUST_ 前缀
#
# 骨架工程不含任何具体业务：只有调试台与 test 线程。
# test 线程是六模块装配的最小可验证单元（线程模板 + 日志 + var + 注册段）。

# ============================================================================

# =================       功能配置区 — 使用开关       ========================

config USE_CMD_SHELL
    bool "Shell debug console (thread + var/log)"
    default y
    select DUST_CMD_SHELL_LOG
    select DUST_CMD_SHELL_VAR
    help
      调试台：控制台线程 + log/var 子命令。

config USE_CMD_CONFIG
    bool "YAML runtime config loader"
    default y
    select DUST_CMD_CONFIG
    help
      各线程的 YAML 参数读取与字段校验（cmd/config）。

# ============================================================================

# =================               TRD_TEST               ====================

config TRD_TEST
    bool "User test thread"
    default y
    help
      骨架自检线程：验证线程模板、日志、var 与注册段装配是否可用。
      不依赖任何外设。
```
