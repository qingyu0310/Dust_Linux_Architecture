## project/Kconfig
```kconfig
# 业务门禁 Kconfig（位置：<repo>/project）
# 业务门禁符号（TRD_ / USE_）保持原名，不加 DUST_ 前缀
# 业务门禁 select 的架构符号统一 DUST_ 前缀
#
# 骨架工程不含任何具体业务：只有调试台与 test 线程。
# test 线程是六模块装配的最小可验证单元（线程模板 + 日志 + var + 注册段）。

# ============================================================================

# =================       功能配置区 — 使用开关       ========================

config USE_CMD_SHELL
    bool "Shell debug console (thread + var/log)"
    default y
    select DUST_CMD_SHELL_LOG
    select DUST_CMD_SHELL_VAR
    help
      调试台：控制台线程 + log/var 子命令。

config USE_CMD_CONFIG
    bool "YAML runtime config loader"
    default y
    select DUST_CMD_CONFIG
    help
      各线程的 YAML 参数读取与字段校验（cmd/config）。

# ============================================================================

# =================            TRD_ETHERCAT             ======================

config TRD_ETHERCAT
    bool "EtherCAT cyclic thread"
    default y
    select DUST_COM_ETHERCAT
    help
      EtherCAT 主站周期线程：每拍发一帧、收一帧，校验工作计数器。
      需要系统已安装 SOEM，且从站接在主站网口的 PORTA。

# ============================================================================

# =================              TRD_CHASSIS              ====================

config TRD_CHASSIS
    bool "Host-side chassis closed-loop control thread"
    default y
    depends on TRD_ETHERCAT
    help
      上位机四轮全向底盘速度环：遥控与电机反馈从 EtherCAT 线程的 topic 读取，
      算出四轮电流后经 topic 交给 EtherCAT 线程写入 RxPDO 电机命令区。
      PDO 电机区布局见 doc/上位机PDO协议说明-2026-11-25.md。

# ============================================================================

# =================               TRD_ROS2               =====================

config TRD_ROS2
    bool "ROS 2 EtherCAT PDO forwarding thread"
    default n
    depends on TRD_ETHERCAT
    select DUST_TPC_ECAT_RX
    help
      将 MCU PDO 发布到 /ecat/rx_pdo，订阅 /ecat/tx_pdo 下发完整命令 PDO。
      需要加载 ROS 2 环境，关闭后不依赖 ROS 2。

# ============================================================================

# =================               TRD_TEST               ====================

config TRD_TEST
    bool "User test thread"
    default n
    help
      骨架自检线程：验证线程模板、日志、var 与注册段装配是否可用。
      不依赖任何外设。
```
